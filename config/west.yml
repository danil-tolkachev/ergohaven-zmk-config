## config/west.yml
```yaml
manifest:
  remotes:
    - name: ergohaven
      url-base: https://github.com/ergohaven
  projects:
    - name: ergohaven-zmk
      remote: ergohaven
      revision: new-qube
      import: config/west.yml
  self:
    path: config
```
